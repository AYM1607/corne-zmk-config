hm: homerow_mods {
    compatible = "zmk,behavior-hold-tap";
    label = "HOMEROW MODS";
    #binding-cells = <2>;
    tapping-term-ms = <100>;
    quick-tap-ms = <200>;
    flavor = "tap-unless-interrupted";
    bindings = <&kp>, <&kp>;
};
