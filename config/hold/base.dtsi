mo_to: behavior_mo_to {
    compatible = "zmk,behavior-hold-tap";
    label = "mo_to";
    #binding-cells = <2>;
    flavor = "hold-preferred";
    tapping-term-ms = <200>;
    bindings = <&mo>, <&to>;
};