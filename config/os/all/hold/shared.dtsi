hm: homerow_mods {
    compatible = "zmk,behavior-hold-tap";
    label = "HOMEROW MODS";
    #binding-cells = <2>;
    tapping-term-ms = <HR_TAPPING>;
    quick-tap-ms = <HR_QUICK_TAP>;
    flavor = HR_FLAVOR;
    bindings = <&kp>, <&kp>;
};

tokp: behavior_to_kp {
    compatible = "zmk,behavior-hold-tap";
    label = "tokp";
    #binding-cells = <2>;
    tapping-term-ms = <HP_TAPPING>;
    flavor = "hold-preferred";
    bindings = <&to>, <&kp>;
};

moto: behavior_mo_to {
    compatible = "zmk,behavior-hold-tap";
    label = "moto";
    #binding-cells = <2>;
    tapping-term-ms = <HP_TAPPING>;
    flavor = "hold-preferred";
    bindings = <&mo>, <&to>;
};
