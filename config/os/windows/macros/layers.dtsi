TO_MACRO(w, DEV)  //to_wDEV
TO_MACRO(w, AXN)  //to_wAXN
TO_MACRO(w, FNK)  //to_wFNK
TO_MACRO(w, STG)  //to_wSTG

MOTO_MACRO(w, AXN, BAS)  //mo_wAXN_to_wBAS
MOTO_MACRO(w, AXN, DEV)  //mo_wAXN_to_wDEV
MOTO_MACRO(w, STG, BAS)  //mo_wSTG_to_wBAS
MOTO_MACRO(w, DEV, BAS)  //mo_wDEV_to_wBAS
MOTO_MACRO(w, FNK, AXN)  //mo_wFNK_to_wAXN

cw_wON: cw_wON {
    compatible = "zmk,behavior-macro";
    label = "cw_wON";
    #binding-cells = <0>;
    bindings =
        <&kp H_wCWR &cw>;
};

cw_wOFF: cw_wOFF {
    compatible = "zmk,behavior-macro";
    label = "cw_wOFF";
    #binding-cells = <0>;
    bindings =
        <&kp LC(H_wCWR) &kp K_CANCEL>;
};