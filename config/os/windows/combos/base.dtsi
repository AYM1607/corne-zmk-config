combo_wCW_on {
    bindings = <&cw_wON>;
    key-positions = <16 19>;
    slow-release;
    layers = <wBAS>;
};

combo_wCW_off {
    bindings = <&cw_wOFF>;
    key-positions = <14 21>;
    slow-release;
    layers = <wBAS>;
};