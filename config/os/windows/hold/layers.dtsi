to_wBAS_kp: behavior_to_wBAS_kp {
    compatible = "zmk,behavior-hold-tap";
    label = "to_wBAS_kp";
    #binding-cells = <2>;
    tapping-term-ms = <HP_TAPPING>;
    flavor = "hold-preferred";
    bindings = <&to_wBAS>, <&kp>;
};

MOTO_HOLD(w, AXN, BAS, FNK) //mo_wAXNwBAS_to_wFNK
MOTO_HOLD(w, AXN, BAS, AXN) //mo_wAXNwBAS_to_wAXN
MOTO_HOLD(w, DEV, BAS, DEV) //mo_wDEVwBAS_to_wDEV
MOTO_HOLD(w, AXN, DEV, BAS) //mo_wAXNwDEV_to_wBAS
MOTO_HOLD(w, AXN, DEV, AXN) //mo_wAXNwDEV_to_wAXN
MOTO_HOLD(w, FNK, AXN, FNK) //mo_wFNKwAXN_to_wFNK
