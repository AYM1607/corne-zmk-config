mp_stg: morph_stg_layer {
    compatible = "zmk,behavior-mod-morph";
    label = "mp_stg";
    #binding-cells = <0>;
    mods = <(MOD_LSFT|MOD_RSFT)>;
    bindings = <&mo_wSTG_to_wBAS>, <&to_wSTG>;
};
