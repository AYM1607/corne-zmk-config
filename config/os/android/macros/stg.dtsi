// action:     apps
m_as_a: macro_android_stg_a {
    compatible = "zmk,behavior-macro";
    label = "m_as_a";
    #binding-cells = <0>;
    wait-ms = <MC_WAIT_START>;
    bindings
        = <&none>
        , <&macro_wait_time MC_WAIT>
        , <&kp LG(RET)>
        , <&kp LC(A)>;
};
