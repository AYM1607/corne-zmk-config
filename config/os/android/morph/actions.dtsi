// tap:     ⇺
// shift:   ⎗
mp_aa_prev: morph_android_action_prev {
    compatible = "zmk,behavior-mod-morph";
    label = "mp_aa_prev";
    #binding-cells = <0>;
    mods = <(MOD_LSFT|MOD_RSFT)>;
    bindings = <&kp RC(PG_UP)>, <&kp LC(LG(LEFT))>;
};

// tap:     ⇻
// shift:   ⎘
mp_aa_next: morph_android_action_next {
    compatible = "zmk,behavior-mod-morph";
    label = "mp_aa_next";
    #binding-cells = <0>;
    mods = <(MOD_LSFT|MOD_RSFT)>;
    bindings = <&kp RC(PG_DN)>, <&kp LC(LG(RIGHT))>;
};
