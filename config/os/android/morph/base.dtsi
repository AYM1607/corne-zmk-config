// tap:     '
// shift:   "
mp_ak_q: morph_android_key_quote {
    compatible = "zmk,behavior-mod-morph";
    label = "mp_ak_q";
    #binding-cells = <0>;
    mods = <(MOD_LSFT|MOD_RSFT)>;
    bindings = <&m_ai_s>, <&m_ai_d>;
};
