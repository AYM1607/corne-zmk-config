mp_a_prev: morph_action_prev {
    compatible = "zmk,behavior-mod-morph";
    label = "⇺ ⎗";
    #binding-cells = <0>;
    mods = <(MOD_LSFT|MOD_RSFT)>;
    bindings = <&kp RC(PG_UP)>, <&kp LC(LG(LEFT))>;
};

mp_a_next: morph_action_next {
    compatible = "zmk,behavior-mod-morph";
    label = "⇻ ⎘";
    #binding-cells = <0>;
    mods = <(MOD_LSFT|MOD_RSFT)>;
    bindings = <&kp RC(PG_DN)>, <&kp LC(LG(RIGHT))>;
};

mp_a_system: morph_action_system {
    compatible = "zmk,behavior-mod-morph";
    label = "ⓘ ⛨";
    #binding-cells = <0>;
    mods = <(MOD_LSFT|MOD_RSFT)>;
    bindings = <&kp LG(PAUSE_BREAK)>, <&kp LC(LA(DEL))>;
};
